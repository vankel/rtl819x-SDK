## bootcode_rtl8198c/config.in
```kconfig
# ATTENTION:
# Brief explaination:
#
# 1. "make menuconfig" will see this file.
# 2. make menuconfig save file will produce "/.config" and "/autoconf.h" two files.
# 3. makefile will see the "/.config" file
# 4. C code will see the "/autoconf.h"  
#
# in this file, declare variable xxx, please add the prefix "CONFIG_" word.  Example: "CONFIG_XXX"





#===========================================================================
mainmenu_name 'RTL Bootcode Configuration'
mainmenu_option next_comment
comment 'Target Platform Selection'
comment 'Choose a Vendor/Product combination.'


#===========================================================================
# Different IC decalre in here.

choice 'Product' "RTL8198C_8954E CONFIG_RTL8198C  \
" RTL8198C_8954E


#===========================================================================
# Different IC want contain with the different config in here 
#



if [ "$CONFIG_RTL8198C" = "y" ] ; then
		define_bool RTL8198 y
		define_bool CONFIG_HISTORY_KEYIN
		define_bool CONFIG_RTL8198 y
		define_bool CONFIG_RTL8881A y
fi


#===========================================================================
# Common Config with every IC have this function in here. Don't litmit someone ic.
#




choice 'is FLASH Type ' "NOR_FLASH  CONFIG_NOR_FLASH \
						 SPI_FLASH  CONFIG_SPI_FLASH \
						 NAND_FLASH_Booting	CONFIG_NAND_FLASH_BOOTING \
						 NONE_FLASH  CONFIG_NONE_FLASH \
						" SPI_FLASH

bool "NAND FLASH SUPPORT" CONFIG_NAND_FLASH	
bool "TFTP SUPPORT COMMAND" CONFIG_TFTP_COMMAND

if [ "$CONFIG_SPI_FLASH" = "y" ]; then
choice 'is SPI IO Type'	"BOOT_SIO_8198_8196C CONFIG_BOOT_SIO_8198 \
					 BOOT_DIO_8198_8196C CONFIG_BOOT_DIO_8198 \
					 BOOT_QIO_8198_8196C CONFIG_BOOT_QIO_8198 \
				      " BOOT_SIO_8198_8196C
bool "SPI CLOCK LIMIT SPEED<40MHz" CONFIG_AUTO_PROBE_LIMITED_SPI_CLK_UNDER_40MHZ
bool "SPI FLASH SINGLE IO MODE(CAN ENABLE DHCP)" CONFIG_SPI_STD_MODE	
#bool "SPI_Booting+NAND_Stroage" CONFIG_NAND_FLASH	
bool "SPI_3to4BYTES_ADDRESS_SUPPORT" CONFIG_SPI_3to4BYTES_ADDRESS_SUPPORT
fi
 

if [ "$CONFIG_NAND_FLASH" = "y" ]|| [ "$CONFIG_NAND_FLASH_BOOTING" = "y" ]; then
choice 'is NAND Type'	"NAND_Flash_Large_Page_5cycles_Pages8KB_8GB CONFIG_NAND_Flash_Large_Page_5cycles_Pages8KB_8GB \
					 NAND_Flash_Large_Page_5cycles_Pages8KB_4GB CONFIG_NAND_Flash_Large_Page_5cycles_Pages8KB_4GB \
					 NAND_Flash_Large_Page_5cycles_Pages4KB CONFIG_NAND_Flash_Large_Page_5cycles_Pages4KB \
					 NAND_Flash_Large_Page_256MBto2GB_5cycles CONFIG_NAND_Flash_Large_Page_256MBto2GB_5cycles \
					 NAND_Flash_Large_Page_128MB_4cycles CONFIG_NAND_Flash_Large_Page_128MB_4cycles \
					 NAND_Flash_Small_Page_64MB_4cycles CONFIG_NAND_Flash_Small_Page_64MB_4cycles \
					 NAND_Flash_Small_Page_32MB_3cycles CONFIG_NAND_Flash_Small_Page_32MB_3cycles \
				      " NAND_Flash_Large_Page_256MBto2GB_5cycles
	bool "NAND flash for BBT support" CONFIG_RTK_NAND_BBT
fi
			
if [ "$CONFIG_NAND_FLASH_BOOTING" = "n" ]; then
	choice 'is SDRAM Type ' "NORMAL  CONFIG_SDRAM \
							 DDR1 CONFIG_DDR1_SDRAM \
							 DDR2/DDR3 CONFIG_DDR2_SDRAM \
							" CONFIG_DDR2_SDRAM

	if [ "$CONFIG_DDR1_SDRAM" = "y" ] || [ "$CONFIG_DDR2_SDRAM" = "y" ]; then
		define_bool CONFIG_DDR_SDRAM y
	fi
fi

if  [ "$CONFIG_NAND_FLASH_BOOTING" = "y" ]; then
choice 'is DRAM Type ' "DDR2  CONFIG_DDR2_SDRAM \
						DDR3 CONFIG_DDR3_SDRAM \
					   " CONFIG_DDR3_SDRAM

#////////////////////NAND+DDR2 configuration////////////////////
if [ "$CONFIG_DDR2_SDRAM" = "y" ]; then
choice 'is DRAM size ' "DDR2_32MB_16bit   CONFIG_DDR2_32MB_16bit  \
						DDR2_64MB_16bit  CONFIG_DDR2_64MB_16bit  \
						DDR2_128MB_16bit  CONFIG_DDR2_128MB_16bit \
					   " CONFIG_DDR2_32MB_16bit
fi

if [ "$CONFIG_DDR2_SDRAM" = "y" ]; then
choice 'is DRAM frequence ' "DDR2_390MHZ   CONFIG_DDR2_390MHZ  \
							" CONFIG_DDR2_390MHZ
fi


#////////////////////NAND+DDR3 configuration////////////////////
if [ "$CONFIG_DDR3_SDRAM" = "y" ]; then
choice 'is DRAM size ' "DDR3_128MB_16bit   CONFIG_DDR3_128MB_16bit  \
						DDR3_256MB_16bit   CONFIG_DDR3_256MB_16bit \
					   " CONFIG_DDR2_32MB_16bit
fi

if [ "$CONFIG_DDR3_SDRAM" = "y" ]; then
choice 'is DRAM frequence ' "DDR3_250MHZ   CONFIG_DDR3_250MHZ  \
							 DDR3_390MHZ   CONFIG_DDR3_390MHZ \
							 DDR3_410MHZ   CONFIG_DDR3_410MHZ \
							 DDR3_490MHZ   CONFIG_DDR3_490MHZ \
							 DDR3_510MHZ   CONFIG_DDR3_510MHZ \
							 DDR3_530MHZ   CONFIG_DDR3_530MHZ \
							 DDR3_550MHZ   CONFIG_DDR3_550MHZ \
							 DDR3_580MHZ   CONFIG_DDR3_580MHZ \
							 DDR3_595MHZ   CONFIG_DDR3_595MHZ \
							 DDR3_640MHZ   CONFIG_DDR3_640MHZ \
							 DDR3_670MHZ   CONFIG_DDR3_670MHZ \
							 DDR3_700MHZ   CONFIG_DDR3_700MHZ \
							#DDR3_740MHZ   CONFIG_DDR3_740MHZ \
						    " CONFIG_DDR3_580MHZ
fi
fi
#CONFIG_NAND_FLASH_BOOTING end

choice 'is SWITCH Type ' "Giga  CONFIG_SW_100M \
						  P0_GMII  CONFIG_SW_P0_GMII \
						  P0_RGMII  CONFIG_SW_P0_RGMII \
						  NONE  CONFIG_SW_NONE \
						 " Giga


bool "Config Spi Flash Number" CONFIG_SPI_FLASH_NUMBER
if [ "$CONFIG_SPI_FLASH_NUMBER" = "y" ]; then
hex 'FLASH_NUMBER' CONFIG_FLASH_NUMBER 0x1
fi

bool "Support Flash Mapping Customize" CONFIG_RTL_FLASH_MAPPING_ENABLE
if [ "$CONFIG_RTL_FLASH_MAPPING_ENABLE" = "y" ]; then
hex 'LINUX image flash offset start' CONFIG_LINUX_IMAGE_OFFSET_START  0x10000
hex 'LINUX image flash offset end'   CONFIG_LINUX_IMAGE_OFFSET_END    0x40000
hex 'lINUX image check step'         CONFIG_LINUX_IMAGE_OFFSET_STEP   0x1000
hex 'ROOT image flash offset start'  CONFIG_ROOT_IMAGE_OFFSET_START  0x100000
hex 'ROOT image flash offset end'    CONFIG_ROOT_IMAGE_OFFSET_END    0x180000
hex 'ROOT image check step'          CONFIG_ROOT_IMAGE_OFFSET_STEP   0x1000
hex 'WEBPAGE image flash offset start'  CONFIG_WEBPAGE_IMAGE_OFFSET_START  0x10000
hex 'WEBPAGE image flash offset end'    CONFIG_WEBPAGE_IMAGE_OFFSET_END    0x40000
hex 'WEBPAGE image check step'          CONFIG_WEBPAGE_IMAGE_OFFSET_STEP   0x1000
fi


bool "Support Flash DualBank" CONFIG_RTL_FLASH_DUAL_IMAGE
if [ "$CONFIG_RTL_FLASH_DUAL_IMAGE" = "y" ]; then
choice 'Mode' "Static CONFIG_RTL_FLASH_DUAL_IMAGE_STATIC  \
Toggle CONFIG_RTL_FLASH_DUAL_IMAGE_ENABLE
" Static
if [ "$CONFIG_RTL_FLASH_DUAL_IMAGE_ENABLE" = "y" ]; then
bool 'Webpage Backup' CONFIG_WEBPAGE_BACKUP
fi
hex 'Second Bank offset' CONFIG_RTL_FLASH_DUAL_IMAGE_OFFSET  0x400000
fi

choice 'compress' "GZIP CONFIG_GZIP_ENABLE  \
LZMA CONFIG_LZMA_ENABLE  \
NONE CONFIG_NONO_COMPRESS  \
" GZIP



bool "Support DualImage(OpenWRT SDK)" CONFIG_RTK_BOOTINFO_DUALIMAGE
if [ "$CONFIG_RTK_BOOTINFO_DUALIMAGE" = "y" ]; then
hex 'Second Bank offset' CONFIG_RTK_DUALIMAGE_FLASH_OFFSET  0x400000
fi

#bool 'LZMA Enable(Default GZip)'		CONFIG_LZMA_ENABLE
bool 'Support DHCP Server'			CONFIG_DHCP_SERVER
bool 'Support HTTP Update'			CONFIG_HTTP_SERVER
bool 'Power On Self Test Enable'		CONFIG_POST_ENABLE
bool 'Boot Code Debug Command Enable'		CONFIG_BOOT_DEBUG_ENABLE
bool 'Support reset botton feature'		CONFIG_BOOT_RESET_ENABLE

#bool 'Update Default Vendor Settings'		CONFIG_DEFAULTS_VENDOR_UPDATE
#bool 'Support History Keyin'		CONFIG_HISTORY_KEYIN

#===========================================================================
# Different IP module. If want to add test IP module, add in here. Can limmit some IC
#

 if [ "$CONFIG_NONE_FLASH" = "y" ]; then
bool 'Enable NFBI'	CONFIG_NFBI
fi

 if [ "$CONFIG_NFBI" = "y" ]; then
choice 'Switch Port5 Type is'		" NFBI_SWITCH_P5_MII_PHY_MODE	CONFIG_NFBI_SWITCH_P5_MII_PHY_MODE \
							NFBI_SWITCH_P5_GMII_MAC_MODE	CONFIG_NFBI_SWITCH_P5_GMII_MAC_MODE \
							" NFBI_SWITCH_P5_MII_PHY_MODE
fi


bool 'Enable JTAG Function for code debugging'	CONFIG_USING_JTAG
#---------------------------------------------------------------------------

#bool 'Enable FPGA_ROMCODE'	CONFIG_FPGA_ROMCODE

#---------------------------------------------------------------------------

#int 'Lxbus Hz'          CONFIG_LXBUS_HZ   25000000
#int 'Lxbus Hz'          CONFIG_LXBUS_HZ   48000000
int 'Lxbus Hz'          CONFIG_LXBUS_HZ   200000000

#bool 'Enable IIS Test'	CONFIG_IIS_TEST
#bool 'Enable RLX5181 Test'	CONFIG_RLX5181_TEST

#bool 'Enable NIC Loopback Feature'	CONFIG_NIC_LOOPBACK
bool 'Support TFTP client'    CONFIG_SUPPORT_TFTP_CLIENT
bool 'Support new console'    CONFIG_NEW_CONSOLE_SUPPORT


#===========================================================================
#bool 'Enable 8198C HW Test'	CONFIG_8198C_HW_TEST				


#---------------------------------------------------------------------------
bool 'Enable DRAM Test'	CONFIG_DRAM_TEST					#2.For DRAM basic R/W test

#===========================================================================
#bool 'DTR calculation'   CONFIG_DTR_CALCULATION
 
#===========================================================================
bool 'RGB LED SUPPORT'   CONFIG_RGB_LED
bool 'ESD SUPPORT' CONFIG_ESD_SUPPORT
bool 'PORT ISOLATION SUPPORT' CONFIG_PORT_ISOLATION_SUPPORT
if [ "$CONFIG_PORT_ISOLATION_SUPPORT" = "y" ]; then
choice 'ISOLATION TYPE ' "LAN_WAN  CONFIG_RTL_LAN_WAN_ISOLATION \
                                                         ALL_PORT CONFIG_RTL_ALL_PORT_ISOLATION \
                                                        " LAN_WAN
fi
#===========================================================================
#bool 'WatchDog_test'	CONFIG_WatchDog_test

#===========================================================================

#---------------------------------------------------------------------------
#bool 'Enable PCIE Test'	CONFIG_PCIE_TEST					

#===========================================================================

#===========================================================================
endmenu
```
