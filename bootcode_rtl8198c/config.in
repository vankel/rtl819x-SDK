## rtl819x/users/Kconfig
```kconfig
#############################################################################

#
#	Kconfig - user applications and library configuration
#

#############################################################################

comment "Applications"
config APP_AP_CONTROLER
	bool "ap controler"
	help
		config ap controler for remote host control ap

config APP_AUTH
	bool "auth"
	help
	  A daemon used for Wireless EAP.

config APP_AUTH_2NDSRV
	bool "	2nd auth srv"
	depends on APP_AUTH
	help
	  Config auth daemon to support dual radius server
source "adapter-api/Kconfig"

config APP_AVAHI
	bool "avahi-0.6.31"
	select LIB_LIBDAEMON
	help
	  A daemon used for Zeroconf under linux.

config APP_BRCTL
	bool "brctl"
	help
	  Brctl is used to set up, maintain, and inspect the ethernet bridge 
	  configuration in the linux kernel.

config APP_BLUEZ
	bool "bluez"
	help
	   bluez is bluetooth utility

source "rtk_bluetooth_firmware/Kconfig"

config APP_BUSYBOX
	bool "busybox"
	help
	  BusyBox combines tiny versions of many common UNIX utilities into
	  a single small executable.  It provides minimalist replacements
	  for most of the utilities you usually find in fileutils, shellutils,
	  findutils, textutils, grep, gzip, tar, etc.  Simply select those
	  utilities and options you want.

config APP_LOGIN_CONSOLE
	bool "login on console"
	help
	  user must login on console if the feature enabled.

config APP_CTORRENT
	bool "Enhanced Ctorrent"
	help
	  Enhanced Ctorrent is a light-weight BT Client on UNIX like OS.

config APP_DCTS
	bool "dcts"
	help
	  dcts is a controller server for Enhanced Ctorrent

config APP_DHCPV6
	bool "dhcpv6"
	help
	  Dhcp daemon for Ipv6.

config APP_DISCOVER
	bool  "discover"
	help
	  Auto Discovery Server
config APP_DNRD
	bool "dnrd"
	help 
	  dns relay for ipv4

config APP_DNSMASQ
	bool "dnsmasq"
	default n
	help
	  dns proxy for IPv4 and IPv6

config APP_DOSFSCK
        bool "dosfsck"
        help
          A tool to check dos file system.

config APP_EXFAT_FUSE
	bool "exfat-fuse"
	help
	  A tool for exfat file system

config APP_GDBSERVER
        bool "gdbserver"
        help
          The gdbserver-6.8 for debug application

config APP_GOAHEAD
	bool "goahead"
	depends on !APP_BOA
	help
	  A simple HTTPD Daemon. It provides web interface of the Wireless Gateway

config APP_BOA
	bool "boa"
	help
	  A simple HTTPD Daemon. It provides web interface of the Wireless Gateway

config APP_BOA_IPV6_SUPPORT
	depends on APP_BOA
	bool "boa IPv6 Support"
	help
	  Make boa web server to support ipv6.

config APP_UWIFI
	bool "uWiFi"
	help
	  A uWiFi package for customer
	  
config APP_ALSA_AUDIO
	bool "alsa related"
	help
	  ALSA Audio

config APP_APPLE_MFI_WAC
	bool "Apple WAC Support"
	select APP_AVAHI
	select LIB_LIBDAEMON
	help
	    Apple Support Package, including WAC wifi audio

config APP_APPLE_HOMEKIT
	bool "Apple Homekit Support"
    	depends on APP_APPLE_MFI_WAC
	help
	    Apple Support Package, including Homekit accessory protocol
	choice 
		prompt "Choose Homekit Services"
		depends on APP_APPLE_HOMEKIT
            config APP_HAP_SWITCH_SERVICE
            bool "Homekit Switch Service"
            depends on APP_APPLE_HOMEKIT
            config APP_HAP_IP_CAM_SERVICE
            bool "Homekit IP Camera Services"
            depends on APP_APPLE_HOMEKIT
    endchoice
config APP_HAP_CAM_SERVICE
bool "Homekit Camera Services"
depends on APP_HAP_IP_CAM_SERVICE
config APP_HAP_MICROPHONE_SERVICE
bool "Homekit Microphone Services"
depends on APP_HAP_IP_CAM_SERVICE
config APP_HAP_SPEAKER_SERVICE
bool "Homekit Speaker Services"
depends on APP_HAP_IP_CAM_SERVICE

config APP_GPROXY
	bool "gproxy"
	help
	  The gproxy daemon
	  
config APP_MULTIPPPOE
	bool "Multi PPPoE Support"
	help
	  Multi PPPoE Support

config APP_IAPP
	bool "iapp"
	help
          The IAPP application

config APP_IGMPPROXY
	bool "igmp proxy"
	help
	  The igmp proxy daemon

config IGMPPROXY_MULTIWAN
	depends on APP_IGMPPROXY
        bool "support igmp proxy multiwan"

config IGMPV3_SUPPORT
	depends on APP_IGMPPROXY
	bool "support igmpv3 proxy"

config APP_MLDPROXY
        bool "mld proxy"
        help
          The mld proxy daemon

config MLDPROXY_MULTIWAN
        depends on APP_MLDPROXY
        bool "support mld proxy multiwan"

#config MLDV2_SUPPORT
#        depends on APP_MLDPROXY
#        bool "support mldv2 proxy"
	   			 
config APP_IPROUTE
	bool "iproute2"
	help
	  The iproute2 daemon

config APP_IPROUTE_IPV6
	depends on APP_IPROUTE
	bool "iproute2 full support"
	help
	  Make iproute2 daemon support ip command

config APP_IPTABLES
	bool "iptables"
	help
	  The iptables daemon

config APP_IP6TABLES
        depends on APP_IPTABLES
	bool "ip6tables"
	help
	  The ip6tables daemon

config APP_L7FILTER_PAT
	bool "l7filter_pat"
	depends on APP_IPTABLES
	help
	  The l7filter pattern

config APP_IWCONTROL
	bool "iwcontrol"
	help
	  The iwcontrol utility.

config APP_L2TPD
	bool "l2tpd"
	help
	  A l2tpd daemon.

config APP_LLTDD
	bool "lltdd"
	help
	  The Link Layer Topology Discovery (LLTD) daemon.

config APP_UPIMAGE
	bool "upImage"
	help
	  update Image through ttyS tool

config APP_MINI_UPNP
	bool "mini_upnp"
	help
	  A Mini-UPNP Daemon and library for miniigd and wsc.

config APP_MINIIGD
	bool "miniigd"
	help
	  A miniigd daemon.

config APP_MINIIGD_IPV6
    depends on APP_MINIIGD
        bool "miniigd ipv6 support"
    help
           Make miniigd support ipv6.


config APP_MKDOSFS
        bool "mkdosfs"
        help
          A tool to make dos file system.

config APP_MP
        bool "mp daemon"
        help
          A mp daemon.

config APP_NTFS3G
	bool "ntfs3g"
	default n
	help
	  NT file system support
		
config APP_NTPCLIENT
	bool "ntpclient"
	help
	  The ntpclient daemon

config APP_OPENSSL
	bool "openssl"
	help
	  The openssl tool.
	default n

comment "Choose openssl version."

	choice 
		prompt "openssl"
		default APP_OPENSSL-0.9.8B
		depends on APP_OPENSSL
			config APP_OPENSSL-0.9.8B
				bool "openssl-0.9.8b"
				help 
					The openssl-0.9.8b tool.
			config APP_OPENSSL-0.9.8I
				bool "openssl-0.9.8i"
				help 
					This version used for toolchain-1.5.5.
	endchoice

#config APP_HOSTAPD_HCM
#	bool "hostapd in host controlled mode"
#	depends on APP_OPENSSL
#	help
#	  The hostap daemon is patched based on 0.6.10

config APP_WAPI
	bool "wapi_utils"
	depends on APP_OPENSSL
	help
	  The wapi certs related applications.
	default n

config APP_ORAYDDNS
	bool "oray ddns"
	help
	  The oray ddns daemon

config APP_PATHSEL
	bool "pathsel"
	help
	  The mesh path selection paemon

config APP_PPPD
	bool "pppd"
	help
	  A ppp daemon.

config APP_PPPD_IPV6CP
    depends on APP_PPPD
        bool "IPv6 over PPP support"
    help
           Make ppp support ipv6.

config  PPPOE_DISCONNECT_FLOW_PATCH
        bool "pppoe_disc_flow_patch"
        help
           A pppoe disconect flow patch.

config  PPP_REJECT_ERROR_SESSION_PATCH
	bool "ppp reject error session patch"
	help
	  A  ppp reject error session patch.

config APP_PPTP
	bool "pptp"
	help
	  A pptp client.

config APP_ECMH
	bool "ecmh"
	help
	  A mld proxy for IPv6

config APP_RADVD
	bool "radvd"
	help
	  radvd daemon for Ipv6.

config APP_RELOAD
	bool "reload"
	help
	  Reload configuration at the end of init.

config APP_ROUTED
	bool "routed"
	help
	   RIP daemon for dynamic routing

config APP_FWD
	bool "firmware write daemon"
	default y 
	help
	  A firmware write daemon.
	  
config APP_RTK_CMD
	bool "rtk_cmd daemon"
	default y 
	help
	  A rtk_cmd daemon.
source "samba/Kconfig"

config APP_SCRIPT
	bool "scripts"
	help
	  The scripts used to init the gw and start the daemons

config APP_SQUASHFS40
	bool "squashfs 4.0"
	help
	  squashfs tools to build image 

config APP_SNMP
	bool "snmp"
	help
	  An SNMP Daemon for network management
 
config APP_TR069
	bool "tr069"
	select APP_ROUTED
	select APP_FLATFSD
	help
	  TR069 Daemon for network management

config USER_CWMP_WITH_TR181
	depends on APP_TR069	
	bool "support TR181 in TR069"

config USER_CWMP_WITH_TR181_V6
	depends on USER_CWMP_WITH_TR181	
	bool "support TR181 V6 part in TR069"

config USER_CWMP_WITH_TR143
	depends on APP_TR069	
	bool "support TR143 in TR069"

config APP_TR104
	bool "support TR104 in TR069"
	depends on APP_TR069
	depends on APP_RTK_VOIP
	help
		TR104 Parameters incorporated with TR069	
		
config APP_FLATFSD
	bool "Flatfs support for TR069"
	depends on APP_TR069
	help
	  flatfsd for tr069 daemon read/write flash in runtime
	
config USER_CWMP_WITH_SSL
	bool
	depends on APP_TR069
	
choice
prompt "Subarchitecture Type"
default USER_CWMP_SSL_NO_SUPPORT
depends on APP_TR069

config USER_CWMP_SSL_NO_SUPPORT
	depends on APP_TR069
	bool "no support any SSL"
		
config USER_CWMP_WITH_OPENSSL
	depends on APP_TR069
	bool "support OPENSSL"
	select USER_CWMP_WITH_SSL
	select APP_OPENSSL
	
config USER_CWMP_WITH_MATRIXSSL
	depends on APP_TR069
	bool "support MATRIXSSL"
	select USER_CWMP_WITH_SSL
	
endchoice

config APP_TRACEROUTE
	bool "traceroute"
	help
	  traceroute support

config APP_UDHCPD
	bool "udhcp" 
	help
	  An embedded DHCP client and server	

config APP_UPDATEDD
	bool "updatedd DDNS"
	help
	  An DDNS daemon for serverl DDNS ISP

config APP_USBMOUNT
	bool "usbmount"
	help
	  The usbmount daemon.

config USBDISK_UPDATE_IMAGE
        depends on APP_USBMOUNT
        bool "usbdisk update image"
        help
          Update image from specific file in usb disk.

config APP_VSFTPD
	bool "vsftpd"
	help
	  The ftp daemon.

config APP_WIRELESSTOOLS
	bool "wireless tools"
	help
	  The wireless tools

config APP_WSC
	bool "wsc daemon"
	select APP_MINI_UPNP
	help
	  The wireless WPS daemon
 
config APP_HOSTAPD
	bool "hostapd 2.0"
	select APP_OPENSSL
	help
	  The hostap daemon in vserion 2.0

config APP_RTK_VOIP
	bool "rtk_voip"
	help
	  The rtk voip

config APP_RTK_VOIP_E8C
	bool "E8C"
	depends on APP_RTK_VOIP
	help
	  The rtk voip-e8c

config APP_PMC_UTILS
	bool "pmc utils"
	select LIB_Z
	help
	  The pmc utils

#config APP_HOSTAPD_SLAVE
#        bool "hostapd_slave"
#        help
#          The hostap_slave daemon in support vserion 0.6.10
	
config APP_RTK_INBAND_CTL
        bool "rtk_inband_ctl"
        help
          This daemon support realtek proprietary inband control

config RTK_INBAND_CTL_AUTO_RECOVER
	depends on APP_RTK_INBAND_CTL
        bool "rtk inband ctl auto recover"
        help
          For rtk inband ctl auto recover when dead
	default y
# config APP_CLOUD_AUTO_RECOVER
#	bool "cloud thread auto recover"
#       depends on RTK_INBAND_CTL_AUTO_RECOVER
#	default n
#	help
#		cloud_device and cloud_misc_app auto recover
config APP_RTK_INBAND_CTL_REPORT_ERROR
        depends on APP_RTK_INBAND_CTL
        bool "report error information"
        help
          Report error information when inband commands failed
config APP_RTK_INBAND_HOST
        bool "rtk inband Host utility sample"
        help
          rtk inband Host utility sample
config APP_RTK_INBAND_HOST_LIBRARY
        depends on APP_RTK_INBAND_HOST
        bool "rtk inband Host as library"
        help
          rtk inband host as shared library
config APP_RTK_INBANDHOST_PTHREAD_LOCK
        depends on APP_RTK_INBAND_HOST
        bool "rtk inband host pthread lock"
        help
          rtk inband host pthread lock, allow multi-thread send inband commands
config APP_RTK_INBAND_HOST_LIBRARY_TEST
        depends on APP_RTK_INBAND_HOST_LIBRARY
        bool "Test rtk inband host library"
        help
          Test rtk inband host shared library

config APP_NFBI
	bool "nfbi"
	help
	  User space program for NFBI.
	  
config APP_NFBI_HOST
	bool "nfbi host"
	help
	  NFBI user space program for Host.
	  
config APP_IOH
	bool "ioh"
	help
	  IOH client & daemon

config APP_NMBS
	bool "nmbs"
	help
	  Nmb server.	  

config APP_AUTORUNIMG
	bool "ulinker autorun image tool"
	help
	  Tool for generate ulinker auto install image.

config APP_SIMPLE_CONFIG
	bool "simple config support"
	help
	  Tool for client mode device connect to AP.

config APP_UBUS
	bool "ubus"
	default n
	help
		ubus support	

comment "USB3G support"
config APP_COMGT
	bool "comgt"
	help
	  GSM dialup script.

config APP_CHAT
	bool "chat"
	help
	  PPP chat.

config APP_LIBUSB
 	bool "libusb"
 	help
 	  libusb.

config APP_USBMODESWITCH
	bool "usb-modeswitch"
	help
	  usb-modeswitch.

config APP_MBPK_EJECT
	bool "mbpk_eject"
	help
	  mbpk_eject.

config APP_USBMODESWITCH_DATA
	bool "usb-modeswitch-data"
	help
	  usb-modeswitch-data.

config APP_USBUTILS
	bool "usbutils"
	help
	  usbutils.

config APP_HUBCTRL
	bool "hub-ctrl"
	help
	  hub-ctrl.

config APP_MNET
	bool "mnet"
	help
	  mnet.

comment "Libraries"

config LIB_LIBDAEMON
	bool "libdaemon-0.14"
	help
	  A lightweight C library that eases the writing of UNIX daemons.
config LIB_PNG
    bool "libpng"
    select LIB_Z
	help
	  A small example library, only for demostration.

config LIB_Z
    bool "zlib"
	help
	  zlib 1.2.5 required by pmc utils

config LIB_NL
    depends on APP_HOSTAPD
    bool "libnl-1.1"
	help
	  library requried by hostapd

config APP_FLEX
	bool "flex library"
	help
	  flex library.

config LIB_FUSE
	bool "fuse library"
	help
		library required by exfat-fuse
		
comment "Debug & Test"

config APP_CLE_SHELL
	bool "cle_shell"
	help
	  for debug and IC test.

config APP_UTILS
	bool "utils"
	help
	  A set of useful utilities for debug and IC test.

config APP_IPERF
	bool "iperf"
	help
	  A modern tool for network performance measurement.

config APP_DHRYSTONE
	bool "dhrystone"
	help
	  A small example, only for demostration.

config APP_IOZONE
	bool "iozone"
	help 
	  A filesystem benchmark tool

config APP_LTP
	bool "ltp"
	help 
	  Linux Test Project

config APP_EXAMPLE
	bool "example"
	help
	  A small example, only for demostration.

config APP_RELOAD
	bool "reload"
	help
	  A periodly checking utility

config APP_DLNA_DMS
	bool "dlna_dms"
	depends on !APP_MINIDLNA
	help
	 ushare daemon

config APP_LIBICONV
	bool "libiconv"
	depends on APP_DLNA_DMS
	help
	 libiconv-1.14
	default y

config APP_MINIDLNA
	bool "minidlna"
	default n
	help
		minidlna deamon

# config APP_CLOUD
#	bool "cloud"
#	default n
#	help
#		cloud daemon
config APP_MT_DAAPD
	bool "mt-daapd"
	help
	 mt-daapd is a program which acts as an iTunes(DAAP) server for Linux and other Posix unixes. It may eventually support Win32 as well.
config APP_SIGMA_UTILS
	bool  "sigma utils"
	help
	  for support sigma test
choice
	prompt "Sigma Program"
	depends on APP_SIGMA_UTILS
	default SIGMA_VHT
	
config SIGMA_VHT
        bool "VHT5G"
        
config SIGMA_HS2
        bool "HS2R1"

config SIGMA_PMF
        bool "PMF"

endchoice
	
config APP_SPEEDTEST
	bool "speedtest"
    default n
	help
	 daemon for speed test
#############################################################################
```

## rtl819x/users/adapter-api/Kconfig
```kconfig
config APP_ADAPTER_API
	bool "adapter api"
	help 
		"this will enable adapter api for integration with RTK SDK"

config APP_RTK_ADAPTER
	bool "rtk api"
	select APP_WAN_CHECKD
	help
		"this will enable basic rtk adatper api"
	depends on APP_ADAPTER_API
config APP_RTK_API_TEST_CASE
	bool "Test case for rtk api"
	help
		"it support rtk api test case with CUnit"
	depends on APP_RTK_ADAPTER

config APP_WAN_CHECKD
        bool "check wan status daemon"
        help
                "this will enable wan status check daemon"
```
