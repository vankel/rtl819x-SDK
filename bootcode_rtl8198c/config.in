## rtl819x/boards/rtl8198C_8954E/config.in
```kconfig
#
# Realtek Semiconductor Corp.
#
# Tony Wu (tonywu@realtek.com)
# Dec. 7, 2009
#

#
# System Config
#
config ARCH_PLATFORM
	string
	default "Sheipa2"

menu "System Configuration"
choice
	prompt "System Type"
	default RTL_8198C_GW

config RTL_8198C_GW
        bool "8198C/8954E GW"
        select RTL_8198C
        select SYS_HAS_EARLY_PRINTK
        help
          This enables support for Realtek RTL8198C demo board

#config RTL_8198C_AP
#        bool "8198C AP"
#        select RTL_8198C
#        select SYS_HAS_EARLY_PRINTK
#        help
#          This enables support for Realtek RTL8198C demo board running AP mode

endchoice

config RTL_8198C_GW
	bool

config RTL_NO_BR_SHORTCUT
        bool
        default y

config RTL_AP_PACKAGE
    bool
    default y if RTL_8198C_AP

config RTL_PCIE_SIMPLE_INIT
	bool
	default y if RTL8192SE
	default y if RTL8192CD

config RTL_WTDOG
	bool "Enable watchdog timer support"

config RTL_USERSPACE_WTDOG
	bool "Enable watchdog timer support in userspace"
	depends on RTL_WTDOG
	default y

config RTL_TIMER_ADJUSTMENT
	bool "Enable timer adjustment support"

config RTL_WEBPAGES_IN_ROOTFS
	bool "Webpages in rootfs support"

config RTL_DEF_SETTING_IN_FW
        bool "default setting in firmware support"
        default y

config RTL819X_SPI_FLASH
	bool "SPI flash support"
config SPI_3to4BYTES_ADDRESS_SUPPORT
        bool "  SPI 32MB support from 3Byte to 4byte mapping"

config PHY_EAT_40MHZ
	bool "819xD clock source at 40Mhz"
	default y

config RTL8198C_OVER_256MB
	bool "Supoort System Memory bigger than > 256MB"
	select HIGHMEM
	select SYS_SUPPORTS_HIGHMEM
        select CPU_SUPPORTS_HIGHMEM
	default n


config RTL_FLASH_DUAL_IMAGE_ENABLE
	bool "Enable Flash Dual Bank support"

config RTL_FLASH_DUAL_IMAGE_WEB_BACKUP_ENABLE
	bool "Enable Flash Dual Bank Webpage Backup Support"
	depends on RTL_FLASH_DUAL_IMAGE_ENABLE

comment "Second Bank Offset"
	depends on RTL_FLASH_DUAL_IMAGE_ENABLE
config RTL_FLASH_DUAL_IMAGE_OFFSET
	hex "offset of Flash"
	depends on RTL_819X && RTL_FLASH_DUAL_IMAGE_ENABLE
	default "0x200000"
	help
          offset of second bank, Normally should be 2M or 4M.

config USB3G_SUPPORT
	bool "USB3G support"
	select HOTPLUG
	#select UEVENT_HELPER_PATH
	select FW_LOADER
	select FIRMWARE_IN_KERNEL
	#select EXTRA_FIRMWARE=""
	select SCSI
	select SCSI_DMA
	select BLK_DEV_SD
	select BLK_DEV_SR
	select SCSI_MULTI_LUN
	select PPP
	select PPP_MULTILINK
	select PPP_FILTER
	select PPP_DEFLATE
	select PPP_BSDCOMP
	select DEFAULTS_KERNEL_2_6
	select USB_SUPPORT
	select USB_ARCH_HAS_HCD
	select USB_ARCH_HAS_OHCI
	select USB_ARCH_HAS_EHCI
	select USB
	select USB_ANNOUNCE_NEW_DEVICES
	select USB_DEVICEFS
	select USB_DEVICE_CLASS
	select USB_MON
	select USB_EHCI_HCD
	select USB_EHCI_ROOT_HUB_TT
	select USB_EHCI_TT_NEWSCHED
	select USB_OHCI_HCD
	select USB_OHCI_LITTLE_ENDIAN
	select USB_STORAGE
	select USB_SERIAL
	select USB_SERIAL_CONSOLE
	select USB_SERIAL_GENERIC
	select USB_SERIAL_OPTION
	select CONFIGFS_FS
	select ZLIB_DEFLATE
	default n

##### 4G_LTE_SUPPORT #####
menuconfig 4G_LTE_SUPPORT
	bool "4G LTE support"
	default n
	help
		"4G LTE support"
if 4G_LTE_SUPPORT
config GCT_GDM7243
	bool "GCT GDM7243"
	select USB_USBNET
	select USB_NET_CDCETHER
	select USB_NET_CDC_EEM
	select USB_NET_RNDIS_HOST
	default n

config ALTAIR
	#bool "ALTAIR"
	select USB_USBNET
	select USB_NET_CDCETHER
	select USB_ACM
	default n
endif
##### 4G_LTE_SUPPORT #####

##### RAID 0/1 SUPPORT #####
config RTL_RAID01_SUPPORT
	bool "Raid 0/1 support"
	select IDE
	select BLK_DEV_IDE_SATA
	select IDE_GD
	select IDE_GD_ATA
	select IDE_PROC_FS
	select ATA
	select ATA_VERBOSE_ERROR
	select SATA_PMP
	select SATA_AHCI_PLATFORM
	select MD
	select BLK_DEV_MD
	select MD_AUTODETECT
	select MD_LINEAR
	select MD_RAID0
	select MD_RAID1
	select MD_MULTIPATH
	select BLK_DEV_DM
	select DM_DEBUG
	select DM_CRYPT
	select DM_SNAPSHOT
	select DM_MIRROR
	select DM_ZERO
	select EXT3_FS
	select EXT3_DEFAULTS_TO_ORDERED
	select EXT3_FS_XATTR
	default n
##### RAID 0/1 SUPPORT #####

config RTL_USB_IP_HOST_SPEEDUP
	bool "Seedup usb samba performance"

config RTL_SENDFILE_PATCH
	bool "Speed up samba write performance"
	select PAGE_SIZE_16KB	
	default y
	
config HTTP_FILE_SERVER_SUPPORT
	bool "Http File server support"

config NO_FLASH_BOOTING_RAMFS_ROOTFS
	bool "no flash booting ramfs as rootfs"
	default n

comment "Support two spi flash"
config RTL_TWO_SPI_FLASH_ENABLE
	bool "two spi flash support"
	default n
	
config  RTL_SPI_FLASH1_SIZE
	hex "Config 1st flash size"
	depends on RTL_819X && RTL_TWO_SPI_FLASH_ENABLE
	default "0x400000"
	help
	  Normally should be 0x400000 or 0x800000.

config  RTL_SPI_FLASH2_SIZE
        hex "Config 2nd flash size"
        depends on RTL_819X && RTL_TWO_SPI_FLASH_ENABLE
        default "0x400000"
        help
          Normally should be 0x400000 or 0x800000.  

config RTL_FLASH_MAPPING_ENABLE
	bool "Enable Flash Mapping"

comment "Flash size 4M or 8M, default 4M"
	depends on RTL_FLASH_MAPPING_ENABLE
comment "USB3G is enable, please set to 0x400000"
	depends on RTL_FLASH_MAPPING_ENABLE && USB3G_SUPPORT
config RTL_FLASH_SIZE
	hex "Size of Flash"
	depends on RTL_819X && RTL_FLASH_MAPPING_ENABLE
	default "0x400000"
	help
          Size of Flash, Normally should be 4M or 8M.

comment "Hardware setting offset,should be 4K alignment"
	depends on RTL_FLASH_MAPPING_ENABLE
config RTL_HW_SETTING_OFFSET
        hex "Hardware setting offset in flash."
        depends on RTL_819X && RTL_FLASH_MAPPING_ENABLE
        default "0x20000"
        help
	  Hardware Setting store in flash from the offset.
	  it should be 4k alignment.

comment "Default setting offset,should be 4K alignment."
	depends on RTL_FLASH_MAPPING_ENABLE
comment "size of default and current setting should be same."
	depends on RTL_FLASH_MAPPING_ENABLE
config RTL_DEFAULT_SETTING_OFFSET
        hex "Default setting offset in flash."
        depends on RTL_819X && RTL_FLASH_MAPPING_ENABLE
        default "0x24000"
        help
	  Default Setting store in flash from the offset.
	  normally the default setting shoud save before current settting.
	  NOTE: make sure it's size is enough for default setting,
		default size is 16K.

comment "Current setting offset,should be 4K alignment."
	depends on RTL_FLASH_MAPPING_ENABLE
config RTL_CURRENT_SETTING_OFFSET
        hex "Current setting offset in flash."
        depends on RTL_819X  && RTL_FLASH_MAPPING_ENABLE
        default "0x2a000"
        help
	  Current Setting store in flash from the offset.
	  normally the current setting saved after default setting.
	  NOTE: make sure it's size is enough for current setting,
		default size is 16K.

comment "Webpage image offset,should be 4K alignment."
	depends on RTL_FLASH_MAPPING_ENABLE
comment "size of web page is normally about 100K."
	depends on RTL_FLASH_MAPPING_ENABLE
config RTL_WEB_PAGES_OFFSET
	hex "webpages image offset in flash."
	depends on RTL_819X && RTL_FLASH_MAPPING_ENABLE
	default "0x30000"
	help
	  Webpages image store in flash from the offset.
	  NOTE: default size is 128K.

comment "Linux image offset,should be 4K alignment."
	depends on RTL_FLASH_MAPPING_ENABLE
comment "this offset MUST between 0x10000~0x80000."
	depends on RTL_FLASH_MAPPING_ENABLE
config RTL_LINUX_IMAGE_OFFSET
        hex "linux image offset in flash."
        depends on RTL_819X  && RTL_FLASH_MAPPING_ENABLE
        default "0x60000"
        help
	  linux image store in flash from the offset.

comment "Root image offset,should be 64K alignment."
	depends on RTL_FLASH_MAPPING_ENABLE
comment "USB3G is enable, please set to 0x230000."
	depends on RTL_FLASH_MAPPING_ENABLE && USB3G_SUPPORT
config RTL_ROOT_IMAGE_OFFSET
        hex "root image offset in flash."
        depends on RTL_819X  && RTL_FLASH_MAPPING_ENABLE
        default "0x1a0000"
        help
	  root image store in flash from the offset.
	  
comment "Flatfs image offset,should be 128K alignment."
	depends on RTL_FLASH_MAPPING_ENABLE
config RTL_FLATFS_IMAGE_OFFSET
        hex "FLATFS image offset in flash."
        depends on RTL_819X  && RTL_FLASH_MAPPING_ENABLE
        default "0x3E0000"
        help
	  flatfs image store in flash from the offset.

# KERNE_STACK_SIZE = PAGE_SIZE<<KERNEL_STACK_SIZE_ORDER
config KERNEL_STACK_SIZE_ORDER
	int "Kenel Stack Size Order Configuration"
	default "3"
	help
	  With Page Size 4K
	  1 for 8K kenel stack size
	  2 for 16K kernel stack size
	  3 for 32K kernel stack size
	  etc...

config RTL_NFBI_MDIO
	bool

config RTL_EAP_RELAY
	bool
	
config RTL_HOSTAPD_SUPPORT
	bool

config RTK_INBAND_HOST_HACK
	bool

config RTL_NFJROM_MP
	bool "build nfjrom image for MP"
	default n

comment "Build rootfs options"

choice
	prompt "File system to mount root"
	help
		This option is mainly to assist to decide how to build rootfs, because
		echo kind of file system for rootfs will uses different flow in our design. 

config ROOTFS_RAMFS
	bool "linux built-in ramfs"
	depends on INITRAMFS_SOURCE != ""

#config ROOTFS_RAMDISK
#	bool "ramdisk"
#	depends on BLK_DEV_RAM

config ROOTFS_SQUASH
	bool "squash fs"
	depends on SQUASHFS

config ROOTFS_JFFS2
	bool "JFFS2 (work on u-boot only)"
	depends on JFFS2_FS

endchoice

config JFFS2_ERASE_SIZE
	hex "Erase size for JFFS2 tool"
	depends on ROOTFS_JFFS2
	default 0x10000
	help 
		This value is for mkfs.jffs2 tool, so bad value may cause kernel
		boot failure. 
		Given 0x1000 and 0x10000 for 4k and 64k flash respectively. 
	
endmenu

#------------------------------------------------------------------------

menu "BSP configuration"

choice 
	prompt "Timer Source"

config ARCH_CEVT_R4K
	bool "Use MIPS internal counter"

config ARCH_CEVT_EXT
	bool "Use DWAPB external timer"

endchoice

config BSP_ENABLE_PCI
	bool "Enable PCI controller"
	default n

config BSP_ENABLE_USB
	bool "Enable USB controller"
	default n

endmenu
```

## rtl819x/boards/rtl89xxC/config.in
```kconfig
config RTL_89xxC
	def_bool y

config ARCH_CPU_RADIAX
    def_bool n

source "../boards/rtl8198/config.in"
source "../boards/rtl89xxC/board_config_model.in"

config ARCH_CPU_RADIAX
    def_bool n
```

## rtl819x/boards/rtl89xxD/config.in
```kconfig
config RTL_89xxD
	def_bool y

config ARCH_CPU_RADIAX
    def_bool n

source "../boards/rtl819xD/config.in"
source "../boards/rtl89xxD/board_config_model.in"

config ARCH_CPU_RADIAX
    def_bool n
```

## rtl819x/boards/rtl89xxE/config.in
```kconfig
config RTL_89xxE
	def_bool y

config ARCH_CPU_RADIAX
    def_bool n

source "../boards/rtl8198C_8954E/config.in"
#source "../boards/rtl89xxE/board_config_model.in"

config ARCH_CPU_RADIAX
    def_bool n
```

## rtl819x/linux-2.6.30/drivers/pci/pcie/rts5229/Kconfig
```kconfig
config PCIE_RTS5229
	boolean "RTS5229 PCIe CardReader support"
	depends on PCIEPORTBUS
	default y
	help
	  This enables PCI Express RTS5229 support.
```

## rtl819x/linux-2.6.30/sound/soc/rtk/Kconfig
```kconfig
config SND_RTL819XD_SOC_I2S
	bool "SoC Audio for the Realtek rtl819XD chips"
	depends on RTL_819XD
	help
	  Say Y if you want to add support for codecs attached to
	  the RTL819XD I2S interfaces.


choice
	prompt "Audio codec select"
	depends on SND_RTL819XD_SOC_I2S
	default SND_RTL819XD_SOC_ALC5628
	config SND_RTL819XD_SOC_ALC5628
		bool "SoC I2S Audio support for RTL819XD - ALC5628"
	config SND_RTL819XD_SOC_ALC5642
		bool "SoC I2S Audio support for RTL819XD - ALC5642"
	config SND_RTL819XD_SOC_ALC5633Q
		bool "SoC I2S Audio support for RTL819XD - ALC5633Q"
	config SND_RTL819XD_SOC_ALC5670
		bool "SoC I2S Audio support for RTL819XD - ALC5670"	
endchoice	  


choice
	prompt "I2S sampling rate select"
	depends on SND_RTL819XD_SOC_I2S
	default SND_RTL819XD_SOC_I2S_48KHZ
	config  SND_RTL819XD_SOC_I2S_8KHZ
		bool "RTL819XD  I2S sampling rate 8KHz"
	config  SND_RTL819XD_SOC_I2S_16KHZ
		bool "RTL819XD  I2S sampling rate 16KHz"
	config  SND_RTL819XD_SOC_I2S_32KHZ
		bool "RTL819XD  I2S sampling rate 32KHz"
	config  SND_RTL819XD_SOC_I2S_48KHZ
		bool "RTL819XD  I2S sampling rate 48KHz"
endchoice


config SND_CODEC_RT5628
	bool
	default y if SND_RTL819XD_SOC_ALC5628


config SND_CODEC_RT5642
	bool
	default y if SND_RTL819XD_SOC_ALC5642
	
config SND_CODEC_RT5670
	bool
	default y if SND_RTL819XD_SOC_ALC5670
```

## rtl819x/linux-3.10/arch/arm/Kconfig.arm
```kconfig
#
# Realtek Semiconductor Corp.
#
# RLX Linux Kernel Configuration
#
# Tony Wu (tonywu@realtek.com)
# Dec. 07, 2008
#

source "../target/selection/config.top"
source "../target/selection/config.soc"

#
# BSP configuration
#
menu "BSP configuration"

choice
	prompt "Timer Clocksource"
	default ARCH_CSRC_JIFFY
	depends on ARCH_RLXARM

config ARCH_CSRC_JIFFY
	bool "Simple kernel jiffies"
	help
	  Use Designware DWC external timer module as monotonic
	  clocksource.

config ARCH_CSRC_DWC
	bool "Designware DWC timer"
	help
	  Use Designware DWC external timer module as monotonic
	  clocksource.

config ARCH_CSRC_CA7
	bool "ARM CA7/CA15 arch timer"
	depends on ARCH_CPU_ARMA7 || ARCH_CPU_ARMA15
	help
	  arch timer module available in Cortex-A7 and Cortex-A15

config ARCH_CSRC_CA9
	bool "ARM CA5/CA9 global timer"
	depends on ARCH_CPU_ARMA5 || ARCH_CPU_ARMA9
	help
	  arch timer module available in Cortex-A5 and Cortex-A9
endchoice

choice
	prompt "Timer Clockevent"
	default ARCH_CEVT_CA7 if ARCH_CPU_ARMA7 || ARCH_CPU_ARMA15
	default ARCH_CEVT_CA9 if ARCH_CPU_ARMA5 || ARCH_CPU_ARMA9
	depends on ARCH_RLXARM

config ARCH_CEVT_DWC
	bool "Designware DWC timer"
	help
	  Use Designware DWC external timer module as clockevent.

config ARCH_CEVT_TWD
	bool "ARM TWD timer"
	depends on ARCH_CPU_ARMA5 || ARCH_CPU_ARMA9
	help
	  A9MP global timer, per-cpu private timer, and
	  per-cpu watchdog timer support.

config ARCH_CEVT_CA7
	bool "ARM CA7/CA15 arch timer"
	depends on ARCH_CPU_ARMA7 || ARCH_CPU_ARMA15
	help
	  Global timer module available in Cortex-A7 and Cortex-A15

config ARCH_CEVT_CA9
	bool "ARM CA5/CA9 global timer"
	depends on ARCH_CPU_ARMA5 || ARCH_CPU_ARMA9
	help
	  Global timer module available in Cortex-A5 and Cortex-A9
endchoice

config BSP_ENABLE_PCI
	bool "Enable PCI controller"
	default n

config BSP_ENABLE_USB
	bool "Enable USB controller"
	default n

endmenu

#
# ARM
#
config RLXARM
	bool
	default y
	select SYS_HAS_EARLY_PRINTK
	select CPU_SUPPORTS_32BIT_KERNEL
	select SYS_SUPPORTS_32BIT_KERNEL
	select ARCH_SUPPORTS_LITTLE_ENDIAN if ARCH_CPU_EL
	select ARCH_SUPPORTS_BIG_ENDIAN if ARCH_CPU_EB
	select ARM_VIC if ARCH_IRQ_VIC
	select ARM_GIC if ARCH_IRQ_GIC
	select HW_HAS_PCI if (ARCH_BUS_PCI && BSP_ENABLE_PCI)
	select HW_HAS_USB if (ARCH_BUS_USB && BSP_ENABLE_USB)
	select ARCH_SUPPORTS_MSI if (ARCH_BUS_PCI_MSI && BSP_ENABLE_PCI)
	select HAVE_ARM_TWD if ARCH_CEVT_TWD
	select HAVE_ARM_GLOBAL_TIMER if ARCH_CEVT_CA9
	select HAVE_ARM_ARCH_TIMER if ARCH_CEVT_CA7
	select GENERIC_CLOCKEVENTS
	select HAVE_SMP if ARCH_CPU_SMP
	select HAVE_ARM_SCU if ARCH_CPU_SCU

#
# CPU
#
config CPU_ARMA5
	bool
	default y if ARCH_CPU_ARMA5
	select CPU_V7

config CPU_ARMA7
	bool
	default y if ARCH_CPU_ARMA7
	select CPU_V7

config CPU_ARMA9
	bool
	default y if ARCH_CPU_ARMA9
	select CPU_V7

config CPU_ARMA12
	bool
	default y if ARCH_CPU_ARMA12
	select CPU_V7

config CPU_ARMA15
	bool
	default y if ARCH_CPU_ARMA15
	select CPU_V7

config CPU_ARM926
	bool
	default y if ARCH_CPU_ARM926

config CPU_ARM946
	bool
	default y if ARCH_CPU_ARM946

#
# CACHE
#
config CPU_HAS_L2C
	bool
	default y if ARCH_CACHE_L2C

#
# BUS
#
config HW_HAS_USB
	bool

config HW_HAS_PCI
        bool

#
# MISC
#
config USE_UAPI
	bool
	default y
	help
	  Starting Linux 3.7, UAPI is enabled.
```
